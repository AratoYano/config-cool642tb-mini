## config/west.yml
```yaml
manifest:
  remotes:
    - name: zmkfirmware
      url-base: https://github.com/zmkfirmware

  projects:
    # 1. ZMK本体（cormoran版・インポート干渉を完全遮断）
    - name: zmk
      url: https://github.com/cormoran/zmk
      revision: v0.3-branch+dya

    # 2. PMW3610最新ドライバ（petejohanson氏の現存する正しいURLへ修正）
    - name: zmk-pmw3610-driver
      url: https://github.com/petejohanson/zmk-pmw3610-driver
      revision: main

    # 3. ZMK Studio連携用モジュール群（すべて公開URL直接指定）
    - name: zmk-module-ble-management
      url: https://github.com/cormoran/zmk-module-ble-management
      revision: main

    - name: zmk-module-settings-rpc
      url: https://github.com/cormoran/zmk-module-settings-rpc
      revision: main

    - name: zmk-module-runtime-input-processor
      url: https://github.com/cormoran/zmk-module-runtime-input-processor
      revision: main

    - name: zmk-behavior-runtime-sensor-rotate
      url: https://github.com/cormoran/zmk-behavior-runtime-sensor-rotate
      revision: main
```
